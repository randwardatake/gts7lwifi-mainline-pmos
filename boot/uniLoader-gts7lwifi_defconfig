## boot/uniLoader-gts7lwifi_defconfig
```kconfig
CONFIG_POSITION_INDEPENDENT=y
CONFIG_LINUX_KRNL_HEADER_IMG=y
CONFIG_SM8250=y
CONFIG_SAMSUNG_GTS7LWIFI=y
CONFIG_TEXT_BASE=0xc0000000
CONFIG_PAYLOAD_ENTRY=0xd0000000
CONFIG_RAMDISK_ENTRY=0xe0000000
```
